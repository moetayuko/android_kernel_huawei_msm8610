/* Copyright (c) 2013, The Linux Foundation. All rights reserved.
 *
 * This program is free software; you can redistribute it and/or modify
 * it under the terms of the GNU General Public License version 2 and
 * only version 2 as published by the Free Software Foundation.
 *
 * This program is distributed in the hope that it will be useful,
 * but WITHOUT ANY WARRANTY; without even the implied warranty of
 * MERCHANTABILITY or FITNESS FOR A PARTICULAR PURPOSE.  See the
 * GNU General Public License for more details.
 */

/*---------------------------------------------------------------------------
 * This file is autogenerated file using gcdb parser. Please do not edit it.
 * Update input XML file to add a new entry or update variable in this file
 * VERSION = "1.0"
 *---------------------------------------------------------------------------*/
&mdss_mdp {
		dsi_tianma_otm9605a_5_qhd_vid: qcom,mdss_dsi_tianma_otm9605a_5_qhd_video {
		qcom,mdss-dsi-panel-name = "TIANMA_OTM9605A_5 QHD video dsi panel";
		qcom,mdss-dsi-panel-controller = <&mdss_dsi0>;
		qcom,mdss-dsi-panel-type = "dsi_video_mode";
		qcom,mdss-dsi-panel-destination = "display_1";
		qcom,mdss-dsi-panel-framerate = <60>;
		qcom,mdss-dsi-virtual-channel-id = <0>;
		qcom,mdss-dsi-stream = <0>;
		qcom,mdss-dsi-panel-width = <540>;
		qcom,mdss-dsi-panel-height = <960>;
		qcom,mdss-dsi-h-front-porch = <100>;
		qcom,mdss-dsi-h-back-porch = <100>;
		qcom,mdss-dsi-h-pulse-width = <4>;
		qcom,mdss-dsi-h-sync-skew = <0>;
		qcom,mdss-dsi-v-back-porch = <32>;
		qcom,mdss-dsi-v-front-porch = <32>;
		qcom,mdss-dsi-v-pulse-width = <2>;
		qcom,mdss-dsi-h-left-border = <0>;
		qcom,mdss-dsi-h-right-border = <0>;
		qcom,mdss-dsi-v-top-border = <0>;
		qcom,mdss-dsi-v-bottom-border = <0>;
		qcom,mdss-dsi-bpp = <24>;
		qcom,mdss-dsi-color-order = <0>;
		qcom,mdss-dsi-underflow-color = <0xff>;
		qcom,mdss-dsi-border-color = <0>;
		qcom,mdss-dsi-on-command = [39 01 00 00 00 00 02 00 00
                               39 01 00 00 00 00 04 FF 96 05 01
                               39 01 00 00 00 00 02 00 80
                               39 01 00 00 00 00 03 FF 96 05
                               39 01 00 00 00 00 02 00 90
                               39 01 00 00 00 00 02 00 00
                               39 01 00 00 00 00 02 A0 00
                               39 01 00 00 00 00 02 00 B4
                               39 01 00 00 00 00 02 C0 50
                               39 01 00 00 00 00 02 00 80
                               39 01 00 00 00 00 03 C1 36 66
                               39 01 00 00 00 00 02 00 89
                               39 01 00 00 00 00 02 C0 01
                               39 01 00 00 00 00 02 00 80
                               39 01 00 00 00 00 02 C4 9C
                               /*modify the PWM frequency*/
                               39 01 00 00 00 00 02 00 B1
                               39 01 00 00 00 00 02 C6 0C
                               39 01 00 00 00 00 02 00 A0
                               39 01 00 00 00 00 02 C1 00
                               39 01 00 00 00 00 02 00 C0
                               39 01 00 00 00 00 02 C5 00
                               39 01 00 00 00 00 02 00 C5
                               39 01 00 00 00 00 02 B0 03
                               39 01 00 00 00 00 02 00 90
                               39 01 00 00 00 00 08 c5 96 19 01 79 33 33 34
                               39 01 00 00 00 00 02 00 A0
                               39 01 00 00 00 00 08 C5 96 16 00 79 33 33 34
                               39 01 00 00 00 00 02 00 00
                               39 01 00 00 00 00 03 D8 5F 5F
                               39 01 00 00 00 00 02 00 00
                               39 01 00 00 00 00 02 D9 3b
                               39 01 00 00 00 00 02 00 B0
                               39 01 00 00 00 00 03 C5 04 28
                               39 01 00 00 00 00 02 00 00
                               39 01 00 00 00 00 11 E1 01 0D 14 0E 07 13 0B 0A 02 06 08 08 0e 12 0d 01
                               39 01 00 00 00 00 02 00 00
                               39 01 00 00 00 00 11 E2 01 0D 14 0E 07 13 0B 0A 02 06 08 08 0e 12 0d 01
                               39 01 00 00 00 00 02 00 80
                               39 01 00 00 00 00 0B CB 05 00 00 00 00 05 00 00 00 00
                               39 01 00 00 00 00 02 00 90
                               39 01 00 00 00 00 10 CB 55 55 00 00 00 00 00 00 00 00 00 00 00 00 00
                               39 01 00 00 00 00 02 00 A0
                               39 01 00 00 00 00 10 CB 00 00 00 00 00 55 55 00 00 00 00 00 00 00 00
                               39 01 00 00 00 00 02 00 B0
                               39 01 00 00 00 00 0B CB 00 00 00 00 00 00 00 00 00 00
                               39 01 00 00 00 00 02 00 C0
                               39 01 00 00 00 00 10 CB 55 55 00 00 00 04 00 04 00 04 00 04 04 04 00
                               39 01 00 00 00 00 02 00 D0
                               39 01 00 00 00 00 10 CB 04 00 00 00 00 55 55 00 00 00 04 00 04 00 04
                               39 01 00 00 00 00 02 00 E0
                               39 01 00 00 00 00 0B CB 00 04 04 04 00 04 00 00 00 00
                               39 01 00 00 00 00 02 00 F0
                               39 01 00 00 00 00 0B CB 0F 00 CC 00 00 0F 00 CC C3 00
                               39 01 00 00 00 00 02 00 80
                               39 01 00 00 00 00 0B CC 25 26 00 00 00 0C 00 0A 00 10
                               39 01 00 00 00 00 02 00 90
                               39 01 00 00 00 00 10 CC 00 0E 02 04 00 06 00 00 00 00 25 26 00 00 00
                               39 01 00 00 00 00 02 00 A0
                               39 01 00 00 00 00 10 CC 0B 00 09 00 0F 00 0D 01 03 00 05 00 00 00 00
                               39 01 00 00 00 00 02 00 B0
                               39 01 00 00 00 00 0B CC 26 25 00 00 00 0D 00 0F 00 09
                               39 01 00 00 00 00 02 00 C0
                               39 01 00 00 00 00 10 CC 00 0B 03 01 00 05 00 00 00 00 26 25 00 00 00
                               39 01 00 00 00 00 02 00 D0
                               39 01 00 00 00 00 10 CC 0E 00 10 00 0A 00 0C 04 02 00 06 00 00 00 00
                               39 01 00 00 00 00 02 00 80
                               39 01 00 00 00 00 0D CE 8B 03 27 8A 03 28 89 03 27 88 03 28
                               39 01 00 00 00 00 02 00 90
                               39 01 00 00 00 00 0F CE 39 0F 27 39 0E 28 00 00 00 00 00 00 00 00
                               39 01 00 00 00 00 02 00 A0
                               39 01 00 00 00 00 0F CE 38 07 03 C0 00 28 00 38 06 03 C1 00 28 00
                               39 01 00 00 00 00 02 00 B0
                               39 01 00 00 00 00 0F CE 38 05 03 C2 00 28 00 38 04 03 C3 00 28 00
                               39 01 00 00 00 00 02 00 C0
                               39 01 00 00 00 00 0F CE 38 03 03 C4 00 28 00 38 02 03 C5 00 28 00
                               39 01 00 00 00 00 02 00 D0
                               39 01 00 00 00 00 0F CE 38 01 03 C6 00 28 00 38 00 03 C7 00 28 00
                               39 01 00 00 00 00 02 00 80
                               39 01 00 00 00 00 0F CF F0 00 00 10 00 00 00 F0 00 00 10 00 00 00
                               39 01 00 00 00 00 02 00 90
                               39 01 00 00 00 00 0F CF F0 00 00 10 00 00 00 F0 00 00 10 00 00 00
                               39 01 00 00 00 00 02 00 A0
                               39 01 00 00 00 00 0F CF F0 00 00 10 00 00 00 F0 00 00 10 00 00 00
                               39 01 00 00 00 00 02 00 B0
                               39 01 00 00 00 00 0F CF F0 00 00 10 00 00 00 F0 00 00 10 00 00 00
                               39 01 00 00 00 00 02 00 C0
                               39 01 00 00 00 00 0B CF 01 01 20 20 00 00 02 01 00 00
                               39 01 00 00 00 00 02 00 00
                               39 01 00 00 00 00 04 FF FF FF FF
                               39 01 00 00 00 00 02 35 01
                               39 01 00 00 00 00 02 51 64
                               39 01 00 00 00 00 02 53 24
                               39 01 00 00 00 00 02 55 01
                               05 01 00 00 78 00 02 11 00
                               05 01 00 00 14 00 02 29 00];
		qcom,mdss-dsi-off-command = [05 01 00 00 32 00 02 28 00
					05 01 00 00 78 00 02 10 00];
		qcom,mdss-dsi-on-command-state = "dsi_lp_mode";
		qcom,mdss-dsi-off-command-state = "dsi_lp_mode";
		qcom,mdss-dsi-h-sync-pulse = <1>;
		qcom,mdss-dsi-traffic-mode = <2>;
		qcom,mdss-dsi-lane-map = <1>;
		qcom,mdss-dsi-bllp-eof-power-mode;
		qcom,mdss-dsi-bllp-power-mode;
		qcom,mdss-dsi-hfpPowerMode;
		qcom,mdss-dsi-hbpPowerMode;
		qcom,mdss-dsi-hsaPowerMode;
		qcom,mdss-dsi-lane-0-state;
		qcom,mdss-dsi-lane-1-state;
		qcom,mdss-dsi-panel-timings = [96 22 17 00 4a 54 1b 26 27 03 04 00];
		qcom,mdss-dsi-t-clk-post = <0x04>;
		qcom,mdss-dsi-t-clk-pre = <0x1b>;
		qcom,mdss-dsi-bl-min-level = <1>;
		qcom,mdss-dsi-bl-max-level = <255>;
		qcom,mdss-dsi-dma-trigger = <4>;
		qcom,mdss-dsi-mdp-trigger = <0>;
		qcom,mdss-dsi-bl-pmic-control-type = "bl_ctrl_wled";
		//qcom,mdss-dsi-bl-pmic-control-type = "bl_ctrl_dcs";
	};
};
