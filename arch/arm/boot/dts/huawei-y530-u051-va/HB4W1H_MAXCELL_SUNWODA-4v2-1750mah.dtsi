/* Copyright (c) 2013, The Linux Foundation. All rights reserved.
 *
 * This program is free software; you can redistribute it and/or modify
 * it under the terms of the GNU General Public License version 2 and
 * only version 2 as published by the Free Software Foundation.
 *
 * This program is distributed in the hope that it will be useful,
 * but WITHOUT ANY WARRANTY; without even the implied warranty of
 * MERCHANTABILITY or FITNESS FOR A PARTICULAR PURPOSE.  See the
 * GNU General Public License for more details.
 */

qcom,qrd-4v2-1750mAh-data {
	qcom,fcc-mah = <1750>;
	qcom,default-rbatt-mohm = <187>;
	qcom,rbatt-capacitive-mohm = <0>;
	qcom,flat-ocv-threshold-uv = <3800000>;
	qcom,max-voltage-uv = <4200000>;
	qcom,v-cutoff-uv = <3400000>;
	qcom,chg-term-ua = <100000>;
	qcom,batt-id-kohm = <110>;
	qcom,batt-name = "HB4W1H_MAXCELL_SUNWODA";

	qcom,warm-bat-decidegc = <420>;
	qcom,warm-bat-mv = <4100>;
	qcom,ibatmax-warm-ma = <800>;

	qcom,cool-bat-decidegc = <0>;
	qcom,cool-bat-mv = <4200>;
	qcom,ibatmax-cool-ma = <0>;

	qcom,hot-bat-decidegc = <520>;
	qcom,cold-bat-decidegc = <0>;
	qcom,rbatt-sf-lut {
		qcom,lut-col-legend = <(-20) 0 25 40 60>;
		qcom,lut-row-legend = <100 95 90 85 80>,
				<75 70 65 60 55>,
				<50 45 40 35 30>,
				<25 20 16 13 11>,
				<10 9 8 7 6>,
				<5 4 3 2 1>,
				<0>;
		qcom,lut-data = <1190 285 100 79 71>,
				<1189 285 100 79 71>,
				<1140 303 105 81 72>,
				<1068 296 107 83 73>,
				<1054 287 113 86 75>,
				<1050 287 123 90 78>,
				<1056 283 132 96 81>,
				<1068 283 131 104 86>,
				<1085 286 106 88 76>,
				<1104 290 102 81 73>,
				<1134 297 103 82 75>,
				<1170 308 106 86 77>,
				<1216 322 109 88 79>,
				<1285 335 113 86 74>,
				<1388 342 114 85 74>,
				<1628 352 115 84 74>,
				<2075 386 114 86 75>,
				<2450 428 126 92 79>,
				<2665 436 147 102 90>,
				<2240 376 140 111 99>,
				<2635 375 144 114 103>,
				<3416 375 149 118 106>,
				<4652 380 156 121 109>,
				<6373 391 162 127 113>,
				<8747 412 174 136 117>,
				<12489 447 185 143 123>,
				<19106 500 198 151 131>,
				<29585 601 220 162 139>,
				<45089 948 259 184 157>,
				<63234 2123 416 257 217>,
				<87126 8572 2485 1224 2065>;
	};

	qcom,fcc-temp-lut {
		qcom,lut-col-legend = <(-20) 0 25 40 60>;
		qcom,lut-data = <1779 1782 1783 1780 1774>;
	};

	qcom,pc-temp-ocv-lut {
		qcom,lut-col-legend = <(-20) 0 25 40 60>;
		qcom,lut-row-legend = <100 95 90 85 80>,
				<75 70 65 60 55>,
				<50 45 40 35 30>,
				<25 20 16 13 11>,
				<10 9 8 7 6>,
				<5 4 3 2 1>,
				<0>;
		qcom,lut-data = <4169 4170 4168 4161 4156>,
				<4076 4104 4109 4107 4104>,
				<4013 4062 4065 4062 4059>,
				<3940 4000 4018 4019 4018>,
				<3898 3951 3977 3981 3980>,
				<3860 3915 3947 3948 3946>,
				<3829 3882 3916 3917 3914>,
				<3804 3852 3881 3885 3884>,
				<3783 3826 3837 3840 3838>,
				<3766 3805 3812 3813 3812>,
				<3749 3787 3794 3795 3795>,
				<3730 3775 3780 3781 3780>,
				<3710 3766 3770 3769 3767>,
				<3688 3753 3762 3756 3746>,
				<3660 3731 3747 3740 3725>,
				<3621 3706 3719 3712 3699>,
				<3562 3685 3686 3679 3666>,
				<3500 3666 3675 3671 3660>,
				<3438 3638 3657 3650 3637>,
				<3390 3601 3616 3613 3597>,
				<3356 3571 3590 3587 3571>,
				<3319 3535 3561 3557 3542>,
				<3284 3495 3527 3523 3509>,
				<3251 3450 3487 3486 3476>,
				<3215 3401 3445 3448 3441>,
				<3180 3351 3400 3406 3402>,
				<3147 3301 3349 3357 3355>,
				<3110 3248 3291 3299 3297>,
				<3080 3188 3221 3227 3224>,
				<3052 3112 3130 3130 3124>,
				<3000 3000 3000 3000 3000>;
	};
};
