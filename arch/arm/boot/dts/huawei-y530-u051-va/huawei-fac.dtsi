 / {
        huawei_fac_info {
                  compatible = "huawei,hw_fac_info";
                  fac,product_name = "Y530_U051";
                  fac,hardware_ver = "HD1Y530M_VERA";
		  fac,software_ver = "MSM8x10_Y530_U051_va";
                  status = "ok";
        };
};
