/* Copyright (c) 2013, The Linux Foundation. All rights reserved.
 *
 * This program is free software; you can redistribute it and/or modify
 * it under the terms of the GNU General Public License version 2 and
 * only version 2 as published by the Free Software Foundation.
 *
 * This program is distributed in the hope that it will be useful,
 * but WITHOUT ANY WARRANTY; without even the implied warranty of
 * MERCHANTABILITY or FITNESS FOR A PARTICULAR PURPOSE.  See the
 * GNU General Public License for more details.
 */

/*---------------------------------------------------------------------------
 * This file is autogenerated file using gcdb parser. Please do not edit it.
 * Update input XML file to add a new entry or update variable in this file
 * VERSION = "1.0"
 *---------------------------------------------------------------------------*/
&mdss_mdp {
	dsi_cmi_otm8018b_4p5_fwvga_video: qcom,mdss_dsi_cmi_otm8018b_4p5_fwvga_video {
		qcom,mdss-dsi-panel-name = "CMI_OTM8018B_FWVGA_VIDEO";
		qcom,cont-splash-enabled;
		qcom,mdss-dsi-panel-controller = <&mdss_dsi0>;
		qcom,mdss-dsi-panel-type = "dsi_video_mode";
		qcom,mdss-dsi-panel-destination = "display_1";
		qcom,mdss-dsi-panel-framerate = <60>;
		qcom,mdss-dsi-virtual-channel-id = <0>;
		qcom,mdss-dsi-stream = <0>;
		qcom,mdss-dsi-panel-width = <480>;
		qcom,mdss-dsi-panel-height = <854>;
		qcom,mdss-dsi-h-front-porch = <108>;
		qcom,mdss-dsi-h-back-porch = <108>;
		qcom,mdss-dsi-h-pulse-width = <12>;
		qcom,mdss-dsi-h-sync-skew = <0>;
		qcom,mdss-dsi-v-back-porch = <16>;
		qcom,mdss-dsi-v-front-porch = <16>;
		qcom,mdss-dsi-v-pulse-width = <4>;
		qcom,mdss-dsi-h-left-border = <0>;
		qcom,mdss-dsi-h-right-border = <0>;
		qcom,mdss-dsi-v-top-border = <0>;
		qcom,mdss-dsi-v-bottom-border = <0>;
		qcom,mdss-dsi-bpp = <24>;
		qcom,mdss-dsi-color-order = <0>;
		qcom,mdss-dsi-underflow-color = <0xff>;
		qcom,mdss-dsi-border-color = <0>;
		qcom,mdss-dsi-on-command = [29 01 00 00 00 00 02 00 00
			29 01 00 00 00 00 04 FF 80 09 01
			29 01 00 00 00 00 02 00 80
			29 01 00 00 00 00 03 FF 80 09
			29 01 00 00 00 00 02 00 8B
			29 01 00 00 00 00 02 B0 40
			29 01 00 00 00 00 02 00 C6
			29 01 00 00 00 00 02 B0 03
			29 01 00 00 00 00 02 00 B1
			29 01 00 00 00 00 02 C6 0A
			29 01 00 00 00 00 02 00 40
			29 01 00 00 00 00 02 B3 45
			29 01 00 00 00 00 02 00 90
			29 01 00 00 00 00 02 B3 02
			29 01 00 00 00 00 02 00 92
			29 01 00 00 00 00 02 B3 45
			29 01 00 00 00 00 02 00 A1
			29 01 00 00 00 00 02 B3 10
			29 01 00 00 00 00 02 00 A7
			29 01 00 00 00 00 02 B3 10
			29 01 00 00 00 00 02 00 80
			29 01 00 00 00 00 06 C0 00 58 00 14 16
			29 01 00 00 00 00 02 00 90
			29 01 00 00 00 00 07 C0 00 44 00 00 00 03
			29 01 00 00 00 00 02 00 A3
			29 01 00 00 00 00 02 C0 1B
			29 01 00 00 00 00 02 00 B4
			29 01 00 00 00 00 03 C0 50 08
			29 01 00 00 00 00 02 00 81
			29 01 00 00 00 00 02 C1 66
			29 01 00 00 00 00 02 00 A0
			29 01 00 00 00 00 02 C1 EA
			29 01 00 00 00 00 02 00 A1
			29 01 00 00 00 00 02 C1 08
			29 01 00 00 00 00 02 00 A6
			29 01 00 00 00 00 04 C1 01 00 00
			29 01 00 00 00 00 02 00 80
			29 01 00 00 00 00 02 C4 30
			29 01 00 00 00 00 02 00 81
			29 01 00 00 00 00 02 C4 83
			29 01 00 00 00 00 02 00 8A
			29 01 00 00 00 00 02 C4 40
			29 01 00 00 00 00 02 00 88
			29 01 00 00 00 00 02 C4 80
			29 01 00 00 00 00 02 00 82
			29 01 00 00 00 00 02 C5 A3
			29 01 00 00 00 00 02 00 90
			29 01 00 00 00 00 05 C5 96 76 01 03
			29 01 00 00 00 00 02 00 B1
			29 01 00 00 00 00 06 C5 A9 15 00 15 00
			29 01 00 00 00 00 02 00 C0
			29 01 00 00 00 00 02 C5 00
			29 01 00 00 00 00 02 00 B2
			29 01 00 00 00 00 05 F5 15 00 15 00
			29 01 00 00 00 00 02 00 80
			29 01 00 00 00 00 07 CE 85 03 00 84 03 00
			29 01 00 00 00 00 02 00 90
			29 01 00 00 00 00 07 CE 33 5C 00 33 5D 00
			29 01 00 00 00 00 02 00 A0
			29 01 00 00 00 00 0F CE 38 03 03 56 00 00 00 38 02 03 57 00 00 00
			29 01 00 00 00 00 02 00 B0
			29 01 00 00 00 00 0F CE 38 01 03 58 00 00 00 38 00 03 59 00 00 00
			29 01 00 00 00 00 02 00 C0
			29 01 00 00 00 00 0F CE 30 00 03 5A 00 00 00 30 01 03 5B 00 00 00
			29 01 00 00 00 00 02 00 D0
			29 01 00 00 00 00 0F CE 30 02 03 5C 00 00 00 30 03 03 5D 00 00 00
			29 01 00 00 00 00 02 00 C7
			29 01 00 00 00 00 02 CF 00
			29 01 00 00 00 00 02 00 C0
			29 01 00 00 00 00 10 CB 00 00 00 00 54 54 54 54 00 54 00 54 00 00 00
			29 01 00 00 00 00 02 00 D0
			29 01 00 00 00 00 10 CB 00 00 00 00 00 00 00 00 00 54 54 54 54 00 54
			29 01 00 00 00 00 02 00 E0
			29 01 00 00 00 00 0A CB 00 54 00 00 00 00 00 00 00
			29 01 00 00 00 00 02 00 80
			29 01 00 00 00 00 0B CC 00 00 00 00 0C 0A 10 0E 00 02
			29 01 00 00 00 00 02 00 90
			29 01 00 00 00 00 10 CC 00 06 00 00 00 00 00 00 00 00 00 00 00 00 0B
			29 01 00 00 00 00 02 00 A0
			29 01 00 00 00 00 10 CC 09 0F 0D 00 01 00 05 00 00 00 00 00 00 00 00
			29 01 00 00 00 00 02 00 B0
			29 01 00 00 00 00 0B CC 00 00 00 00 0D 0F 09 0B 00 05
			29 01 00 00 00 00 02 00 C0
			29 01 00 00 00 00 10 CC 00 01 00 00 00 00 00 00 00 00 00 00 00 00 0E
			29 01 00 00 00 00 02 00 D0
			29 01 00 00 00 00 10 CC 10 0A 0C 00 06 00 02 00 00 00 00 00 00 00 00
			29 01 00 00 00 00 02 00 00
			29 01 00 00 00 00 03 D8 7F 7F
			29 01 00 00 00 00 02 00 00
			29 01 00 00 00 00 11 E1 01 05 0E 0E 07 11 0B 0A 04 08 0E 09 10 15 0C 06
			29 01 00 00 00 00 02 00 00
			29 01 00 00 00 00 11 E2 01 05 0E 0E 07 11 0B 0A 04 08 0E 09 10 15 0C 06
			29 01 00 00 00 00 02 00 00
			29 01 00 00 00 00 22 EC 40 44 44 44 44 44 44 44 44 44 44 44 44 44 44 44 34 33 33 33 33 33 33 33 33 33 33 33 33 33 33 33 03
			29 01 00 00 00 00 02 00 00
			29 01 00 00 00 00 22 ED 40 44 44 44 44 44 44 44 44 44 44 44 44 44 44 44 44 44 44 44 44 44 44 44 34 33 33 33 33 33 33 33 03
			29 01 00 00 00 00 02 00 00
			29 01 00 00 00 00 22 EE 40 44 44 44 44 44 44 44 44 44 44 44 44 44 44 44 44 44 44 44 44 44 44 44 44 44 44 44 44 44 44 44 04
			29 01 00 00 00 00 02 00 00
			29 01 00 00 00 00 04 FF 00 00 00
			15 01 00 00 00 00 02 51 00
			15 01 00 00 00 00 02 53 24
			15 01 00 00 00 00 02 55 01
			05 01 00 00 78 00 02 11 00
			05 01 00 00 14 00 02 29 00];
		qcom,mdss-dsi-off-command = [05 01 00 00 14 00 02 28 00
					05 01 00 00 78 00 02 10 00];
		qcom,mdss-dsi-on-command-state = "dsi_lp_mode";
		qcom,mdss-dsi-off-command-state = "dsi_hs_mode";
		qcom,mdss-dsi-h-sync-pulse = <1>;
		qcom,mdss-dsi-traffic-mode = <2>;
		qcom,mdss-dsi-lane-map = <1>;
		qcom,mdss-dsi-bllp-eof-power-mode;
		qcom,mdss-dsi-bllp-power-mode;
		qcom,mdss-dsi-lane-0-state;
		qcom,mdss-dsi-lane-1-state;
		qcom,mdss-dsi-panel-timings = [80 1d 13 00 42 46 18 20 20 03 04 00];
		qcom,mdss-dsi-t-clk-post = <0x04>;
		qcom,mdss-dsi-t-clk-pre = <0x19>;
		qcom,mdss-dsi-bl-min-level = <1>;
		qcom,mdss-dsi-bl-max-level = <255>;
		qcom,mdss-dsi-dma-trigger = <4>;
		qcom,mdss-dsi-mdp-trigger = <0>;
		qcom,mdss-dsi-bl-pmic-control-type = "bl_ctrl_dcs";
		qcom,panel-cabc-ui-cmds = [15 01 00 00 00 00 02 55 01
					15 01 00 00 00 00 02 53 24];
		qcom,panel-cabc-video-cmds = [15 01 00 00 00 00 02 55 03
					15 01 00 00 00 00 02 53 2C];
		qcom,cabc-ui-cmds-dsi-state = "dsi_hs_mode";
		qcom,cabc-video-cmds-dsi-state = "dsi_hs_mode";
	};
};
