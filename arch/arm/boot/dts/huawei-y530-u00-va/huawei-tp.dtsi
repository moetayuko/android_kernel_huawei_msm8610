&soc{
	i2c@f9923000{
		synaptics@70 {
			compatible = "synaptics,rmi4";
			reg = <0x70>;
			interrupt-parent = <&msmgpio>;
			interrupts = <1 0x2>;
			vdd-supply = <&pm8110_l19>;
			vcc_i2c-supply = <&pm8110_l14>;
			synaptics,vdd = "vdd";
		       synaptics,vbus = "vcc_i2c";
			synaptics,reset_gpio_num = <0>;
			synaptics,irq_gpio_num = <1>;
			synaptics,irq_gpio_polarity = <0>;/*attn_polarity =RMI_ATTN_ACTIVE_LOW,add irq trigger=IRQF_TRIGGER_FALLING*/
			synaptics,reset_delay_ms = <100>;
		};
	};
};
