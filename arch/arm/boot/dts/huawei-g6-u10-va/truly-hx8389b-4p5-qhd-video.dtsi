//add truly hx8389b LCD driver for G6 
/* recreat lcd dts in fc1 baseline */
/* Copyright (c) 2013, The Linux Foundation. All rights reserved.
 *
 * This program is free software; you can redistribute it and/or modify
 * it under the terms of the GNU General Public License version 2 and
 * only version 2 as published by the Free Software Foundation.
 *
 * This program is distributed in the hope that it will be useful,
 * but WITHOUT ANY WARRANTY; without even the implied warranty of
 * MERCHANTABILITY or FITNESS FOR A PARTICULAR PURPOSE.  See the
 * GNU General Public License for more details.
 */

&mdss_mdp {
	dsi_truly_hx8389b_4p5_qhd_video: qcom,mdss_dsi_truly_hx8389b_4p5_qhd_video {
		qcom,mdss-dsi-panel-name = "TRULY_HX8389B_4P5_QHD_VIDEO";
		qcom,mdss-dsi-panel-controller = <&mdss_dsi0>;
		qcom,mdss-dsi-panel-type = "dsi_video_mode";
		qcom,mdss-dsi-panel-destination = "display_1";
		qcom,mdss-dsi-panel-framerate = <60>;
		qcom,mdss-dsi-virtual-channel-id = <0>;
		qcom,mdss-dsi-stream = <0>;
		qcom,mdss-dsi-panel-width = <540>;
		qcom,mdss-dsi-panel-height = <960>;
		qcom,mdss-dsi-h-front-porch = <40>;
		qcom,mdss-dsi-h-back-porch = <40>;
		qcom,mdss-dsi-h-pulse-width = <40>;
		qcom,mdss-dsi-h-sync-skew = <0>;
		qcom,mdss-dsi-v-back-porch = <9>;
		qcom,mdss-dsi-v-front-porch = <5>;
		qcom,mdss-dsi-v-pulse-width = <3>;
		qcom,mdss-dsi-h-left-border = <0>;
		qcom,mdss-dsi-h-right-border = <0>;
		qcom,mdss-dsi-v-top-border = <0>;
		qcom,mdss-dsi-v-bottom-border = <0>;
		qcom,mdss-dsi-bpp = <24>;
		qcom,mdss-dsi-color-order = <0>;
		qcom,mdss-dsi-underflow-color = <0xff>;
		qcom,mdss-dsi-border-color = <0>;
                qcom,mdss-dsi-on-command = [39 01 00 00 00 00 04 B9 FF 83 89
                                      39 01 00 00 00 00 03 BA 41 93
                                      39 01 00 00 00 00 02 C6 08
                                      39 01 00 00 00 00 03 DE 05 58
                                      39 01 00 00 00 00 14 B1 00 00 04 E3 9A 10 11 8F EF 28 30 23 23 42 00 3A F5 20 00
                                      39 01 00 00 00 00 18 B4 80 08 00 32 10 00 00 00 00 00 00 00 37 0A 40 04 37 0A 40 14 50 55 0A
                                      39 01 00 00 00 00 08 B2 00 00 78 08 03 3F 80
                                      //modify the GAMMA init code
                                      39 01 00 00 00 00 80
                                            C1 01 01 0A 15 1D 25 2D 33 3B 43 4B 52 5A 62 69
                                            71 78 80 87 8F 97 9F A7 AF B7 C0 C8 CE D6 E0 E7
                                            EF F8 FF 50 ED 8E 77 68 1F 13 8C C0 01 0A 15 1D
                                            25 2D 33 3B 43 4B 52 5A 62 69 71 78 80 87 8F 97
                                            9F A7 AF B7 C0 C8 CE D6 E0 E7 EF F8 FF 50 ED 8E
                                            77 68 1F 13 8C C0 01 0A 15 1D 25 2D 33 3B 43 4B
                                            52 5A 62 69 71 78 80 87 8F 97 9F A7 AF B7 C0 C8
                                            CE D6 E0 E7 EF F8 FF 50 ED 8E 77 68 1F 13 8C C0
                                      39 01 00 00 00 00 31
                                            D5 00 00 4C 00 01 00 00 00 60 00 99 88 99 88 88
                                            32 88 10 88 76 88 54 10 32 88 88 88 88 88 88 99
                                            88 99 88 45 88 67 88 01 88 23 23 01 88 88 88 88
                                            88
                                      39 01 00 00 00 00 23
                                             E0 03 12 15 29 31 3F 1C 39 06 0D 0E 10 12 11 12
                                             11 1A 03 12 15 29 31 3F 1C 39 06 0D 0E 10 12 11
                                             12 11 1A
                                      39 01 00 00 05 00 0A C9 0F 02 1E 1E 00 00 00 01 3E
                                      39 01 00 00 00 00 03 B6 00 96
                                      39 01 00 00 00 00 02 CC 02
                                      39 01 00 00 00 00 03 CB 07 07
                                      39 01 00 00 00 00 04 B7 00 00 5A
                                      39 01 00 00 00 00 05 BB 00 00 FF 80
                                      39 01 00 00 00 00 02 51 00
                                      39 01 00 00 00 00 02 53 24
                                      39 01 00 00 00 00 02 55 01
                                      05 01 00 00 78 00 02 11 00
                                      39 01 00 00 00 00 02 c6 0c
                                      05 01 00 00 14 00 02 29 00];
		qcom,mdss-dsi-off-command = [05 01 00 00 32 00 02 28 00
					05 01 00 00 78 00 02 10 00];
		qcom,mdss-dsi-on-command-state = "dsi_lp_mode";
		qcom,mdss-dsi-off-command-state = "dsi_lp_mode";
		qcom,mdss-dsi-h-sync-pulse = <1>;
		qcom,mdss-dsi-traffic-mode = <2>;
		qcom,mdss-dsi-lane-map = <1>;
		qcom,mdss-dsi-bllp-eof-power-mode;
		qcom,mdss-dsi-bllp-power-mode;
		qcom,mdss-dsi-lane-0-state;
		qcom,mdss-dsi-lane-1-state;
		qcom,mdss-dsi-panel-timings = [83 1d 13 00 42 4d 18 20 21 03 04 00];
		qcom,mdss-dsi-t-clk-post = <0x04>;
		qcom,mdss-dsi-t-clk-pre = <0x1c>;
		qcom,mdss-dsi-bl-min-level = <1>;
		qcom,mdss-dsi-bl-max-level = <255>;
		qcom,mdss-dsi-dma-trigger = <4>;
		qcom,mdss-dsi-mdp-trigger = <0>;
		qcom,mdss-dsi-bl-pmic-control-type = "bl_ctrl_dcs";
		qcom,panel-cabc-ui-cmds = [13 01 00 00 00 02 55 01
						13 01 00 00 00 02 53 24];
		qcom,cabc-ui-cmds-dsi-state = "DSI_LP_MODE";
		qcom,panel-cabc-video-cmds = [13 01 00 00 00 02 55 03
						13 01 00 00 00 02 53 2c];
		qcom,cabc-video-cmds-dsi-state = "DSI_LP_MODE";
		qcom,panel-gamma-22-cmds = [13 01 00 00 00 02 55 01
						13 01 00 00 00 02 53 24];
		qcom,gamma-22-cmds-dsi-state = "DSI_LP_MODE";
		qcom,panel-gamma-25-cmds = [13 01 00 00 00 02 55 03
						13 01 00 00 00 02 53 2c];
		qcom,gamma-25-cmds-dsi-state = "DSI_LP_MODE";
	};
};
