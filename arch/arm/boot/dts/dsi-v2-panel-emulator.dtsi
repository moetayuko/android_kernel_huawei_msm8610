//modify the timingsetting
/* Copyright (c) 2013, The Linux Foundation. All rights reserved.
 *
 * This program is free software; you can redistribute it and/or modify
 * it under the terms of the GNU General Public License version 2 and
 * only version 2 as published by the Free Software Foundation.
 *
 * This program is distributed in the hope that it will be useful,
 * but WITHOUT ANY WARRANTY; without even the implied warranty of
 * MERCHANTABILITY or FITNESS FOR A PARTICULAR PURPOSE.  See the
 * GNU General Public License for more details.
 */

/ {
        qcom,dsi_v2_emulator {
                compatible = "huawei,lcd_panel_idA"; /* this panel id only for emulator, copy form dsi-v2-panel-hx8389b-qhd-video.dtsi*/
                label = "EMULATOR_PANEL";
                qcom,dsi-ctrl-phandle = <&mdss_dsi0>;
                qcom,rst-gpio = <&msmgpio 41 0>;
                vdda-supply = <&pm8110_l19>;
                vddio-supply=<&pm8110_l6>;
                qcom,mdss-pan-res = <540 960>;
                qcom,mdss-pan-bpp = <24>;
                qcom,mdss-pan-dest = "display_1";
                qcom,mdss-pan-porch-values = <96 5 96 15 5 10>;
                qcom,mdss-pan-underflow-clr = <0xff>;
                qcom,mdss-pan-bl-levels = <1 255>;
                qcom,mdss-pan-bl-ctrl = "bl_ctrl_wled";
                qcom,mdss-pan-dsi-mode = <0>;
                qcom,mdss-pan-dsi-h-pulse-mode = <1>;
                qcom,mdss-pan-dsi-h-power-stop = <1 1 1>;
                qcom,mdss-pan-dsi-bllp-power-stop = <1 1>;
                qcom,mdss-pan-dsi-traffic-mode = <2>;
                qcom,mdss-pan-dsi-dst-format = <3>;
                qcom,mdss-pan-dsi-vc = <0>;
                qcom,mdss-pan-dsi-rgb-swap = <0>;
                qcom,mdss-pan-dsi-data-lanes = <1 1 0 0>;
                qcom,mdss-pan-dsi-dlane-swap = <1>;
                qcom,mdss-pan-dsi-t-clk = <0x1f 0x04>;
                qcom,mdss-pan-dsi-stream = <0>;
                qcom,mdss-pan-dsi-mdp-tr = <0x0>;/*todo*/
                qcom,mdss-pan-dsi-dma-tr = <0x04>;
                qcom,mdss-pan-dsi-frame-rate = <60>;
                qcom,panel-phy-regulatorSettings =[09 08 05 00 20 03];
                //modify params according porch setting
                qcom,panel-phy-timingSettings = [92 21 15  00 48 4f
                                                1a 25 25  03 04 00];
                qcom,panel-phy-strengthCtrl = [ff 06];
                qcom,panel-phy-bistCtrl = [03 03 00 00 0f 00];
                qcom,panel-phy-laneConfig =
                                        [80 45 00 00 01 66 /*lane0**/
                                        80 45 00 00 01 66 /*lane1*/
                                        80 45 00 00 01 66 /*lane2*/
                                        80 45 00 00 01 66 /*lane3*/
                                        40 67 00 00 01 88]; /*Clk*/

                qcom,on-cmds-dsi-state = "DSI_LP_MODE";
                qcom,panel-on-cmds = [05 01 00 00 0a 02
                                                11 00
                                      05 01 00 00 78 02
                                                29 00];
                qcom,panel-off-cmds = [05 01 00 00 32 02 28 00
                                       05 01 00 00 78 02 10 00];
                qcom,off-cmds-dsi-state = "DSI_LP_MODE";
        };
};
