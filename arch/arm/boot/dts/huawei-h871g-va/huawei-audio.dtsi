/ {
        huawei_audio_info {
                  compatible = "huawei,hw_audio_info";
                  builtin-mic-type = "single";
                  product-identifier = "H871G";
                  status = "ok";
                  aud_param_ver = "H871G_audio_default";
                  builtin-master-mic-exist;
                  hand_held_master_mic_strategy;
                  loud_speaker_master_mic_strategy;
                  product-btsco-nrec-adapt;
        };
};
&soc {
    sound {
        qcom,audio-routing =
            "RX_BIAS", "MCLK",
            "INT_LDO_H", "MCLK",
            "MIC BIAS External", "Handset Mic",
            "MIC BIAS External", "Headset Mic",
            "AMIC1", "MIC BIAS External",
            "AMIC2", "MIC BIAS External",
	    "AMIC3", "MIC BIAS External";
    };
};
