 / {
        huawei_fac_info {
                  compatible = "huawei,hw_fac_info";
                  fac,product_name = "HUAWEI C8816D";
                  fac,hardware_ver = "HS1G620M_VERA";
		  fac,software_ver = "MSM8x12_G620D_va";
                  status = "ok";
        };
};
