/* Copyright (c) 2013, The Linux Foundation. All rights reserved.
 *
 * This program is free software; you can redistribute it and/or modify
 * it under the terms of the GNU General Public License version 2 and
 * only version 2 as published by the Free Software Foundation.
 *
 * This program is distributed in the hope that it will be useful,
 * but WITHOUT ANY WARRANTY; without even the implied warranty of
 * MERCHANTABILITY or FITNESS FOR A PARTICULAR PURPOSE.  See the
 * GNU General Public License for more details.
 */

qcom,qrd-4v35-2500mAh-data {
	qcom,fcc-mah = <2400>;
	qcom,default-rbatt-mohm = <150>;
	qcom,rbatt-capacitive-mohm = <0>;
	qcom,flat-ocv-threshold-uv = <3800000>;
	qcom,max-voltage-uv = <4350000>;
	qcom,v-cutoff-uv = <3400000>;
	qcom,chg-term-ua = <100000>;
	qcom,batt-id-kohm = <110>;
	qcom,batt-name = "HB4742A0RBW_SCUD";

	qcom,rbatt-sf-lut {
		qcom,lut-col-legend = <(-20) 0 25 40 60>;
		qcom,lut-row-legend = <100 95 90 85 80>,
				<75 70 65 60 55>,
				<50 45 40 35 30>,
				<25 20 16 13 11>,
				<10 9 8 7 6>,
				<5 4 3 2 1>;
		qcom,lut-data = <1316 296 100 78 72>,
				<1316 296 100 78 72>,
				<1276 296 102 79 72>,
				<1239 297 105 82 73>,
				<1210 297 110 84 74>,
				<1196 291 116 88 76>,
				<1188 284 120 92 79>,
				<1193 282 120 97 82>,
				<1211 282 108 92 83>,
				<1244 284 102 82 74>,
				<1279 290 102 80 73>,
				<1323 296 106 82 74>,
				<1377 308 108 84 76>,
				<1440 324 112 87 77>,
				<1522 342 112 88 76>,
				<1666 364 110 83 74>,
				<2018 387 109 84 75>,
				<2365 406 111 84 75>,
				<2628 423 111 83 75>,
				<2386 408 110 83 75>,
				<2675 425 112 84 75>,
				<3146 450 115 86 76>,
				<3799 484 119 86 76>,
				<4778 527 121 87 76>,
				<6328 584 121 86 76>,
				<8920 658 122 86 76>,
				<13766 787 128 88 78>,
				<23616 1086 138 92 79>,
				<46446 2326 156 100 87>,
				<99921 6845 207 142 122>;
	};

	qcom,fcc-temp-lut {
		qcom,lut-col-legend = <(-20) 0 25 40 60>;
		qcom,lut-data = <2450 2459 2462 2456 2444>;
	};

	qcom,pc-temp-ocv-lut {
		qcom,lut-col-legend = <(-20) 0 25 40 60>;
		qcom,lut-row-legend = <100 95 90 85 80>,
				<75 70 65 60 55>,
				<50 45 40 35 30>,
				<25 20 16 13 11>,
				<10 9 8 7 6>,
				<5 4 3 2 1>,
				<0>;
		qcom,lut-data = <4350 4348 4343 4339 4332>,
				<4211 4248 4259 4259 4256>,
				<4130 4185 4200 4200 4197>,
				<4061 4127 4145 4146 4143>,
				<4000 4072 4093 4094 4092>,
				<3946 4018 4044 4045 4044>,
				<3899 3966 3997 4000 4000>,
				<3857 3922 3951 3957 3958>,
				<3823 3884 3905 3913 3916>,
				<3796 3851 3869 3872 3873>,
				<3772 3822 3841 3843 3843>,
				<3750 3797 3817 3820 3820>,
				<3730 3779 3798 3801 3800>,
				<3711 3764 3781 3784 3783>,
				<3692 3751 3765 3766 3762>,
				<3672 3735 3746 3742 3731>,
				<3647 3713 3725 3721 3710>,
				<3622 3689 3704 3701 3689>,
				<3599 3668 3683 3681 3671>,
				<3582 3652 3672 3671 3662>,
				<3570 3644 3668 3668 3659>,
				<3556 3634 3663 3665 3655>,
				<3539 3624 3656 3659 3649>,
				<3519 3610 3644 3647 3637>,
				<3495 3590 3618 3621 3608>,
				<3466 3558 3576 3579 3566>,
				<3428 3508 3522 3526 3514>,
				<3379 3439 3453 3458 3447>,
				<3304 3345 3360 3366 3358>,
				<3183 3212 3219 3230 3227>,
				<3000 3000 3000 3000 3000>;
	};
};
