//modify the timingsetting and PWM frequency
/* recreat lcd dts in fc1 baseline */
/* Copyright (c) 2013, The Linux Foundation. All rights reserved.
 *
 * This program is free software; you can redistribute it and/or modify
 * it under the terms of the GNU General Public License version 2 and
 * only version 2 as published by the Free Software Foundation.
 *
 * This program is distributed in the hope that it will be useful,
 * but WITHOUT ANY WARRANTY; without even the implied warranty of
 * MERCHANTABILITY or FITNESS FOR A PARTICULAR PURPOSE.  See the
 * GNU General Public License for more details.
 */
&mdss_mdp {
		dsi_byd_nt35517_5p5_qhd_vid: qcom,mdss_dsi_byd_nt35517_5p5_qhd_video {
		qcom,mdss-dsi-panel-name = "BYD_NT35517_QHD_VIDEO";
		qcom,mdss-dsi-panel-controller = <&mdss_dsi0>;
		qcom,mdss-dsi-panel-type = "dsi_video_mode";
		qcom,mdss-dsi-panel-destination = "display_1";
		qcom,mdss-dsi-panel-framerate = <60>;
		qcom,mdss-dsi-virtual-channel-id = <0>;
		qcom,mdss-dsi-stream = <0>;
		qcom,mdss-dsi-panel-width = <540>;
		qcom,mdss-dsi-panel-height = <960>;
		qcom,mdss-dsi-h-front-porch = <11>;
		qcom,mdss-dsi-h-back-porch = <3>;
		qcom,mdss-dsi-h-pulse-width = <15>;
		qcom,mdss-dsi-h-sync-skew = <0>;
		qcom,mdss-dsi-v-back-porch = <11>;
		qcom,mdss-dsi-v-front-porch = <3>;
		qcom,mdss-dsi-v-pulse-width = <15>;
		qcom,mdss-dsi-h-left-border = <0>;
		qcom,mdss-dsi-h-right-border = <0>;
		qcom,mdss-dsi-v-top-border = <0>;
		qcom,mdss-dsi-v-bottom-border = <0>;
		qcom,mdss-dsi-bpp = <24>;
		qcom,mdss-dsi-color-order = <0>;
		qcom,mdss-dsi-underflow-color = <0xff>;
		qcom,mdss-dsi-border-color = <0>;
		qcom,mdss-dsi-on-command = [39 01 00 00 00 00 06
                                                F0 55 AA 52 08 00
                                        39 01 00 00 00 00 02
                                                B3 82
                                        39 01 00 00 00 00 02
                                                BC 00
                                        /*modify the PWM frequency*/
                                        39 01 00 00 00 00 03
                                                E0 00 01
                                        39 01 00 00 00 00 06
                                                F0 55 AA 52 08 01
                                        39 01 00 00 00 00 02
                                                C0 C0
                                        39 01 00 00 00 00 02
                                                C2 20
                                        39 01 00 00 00 00 02
                                                B0 05
                                        39 01 00 00 00 00 02
                                                B6 44
                                        39 01 00 00 00 00 02
                                                B1 05
                                        39 01 00 00 00 00 02
                                                B7 34
                                        39 01 00 00 00 00 02
                                                B2 02
                                        39 01 00 00 00 00 02
                                                B8 13
                                        39 01 00 00 00 00 02
                                                B3 0E
                                        39 01 00 00 00 00 02
                                                B9 23
                                        39 01 00 00 00 00 02
                                                B4 08
                                        39 01 00 00 00 00 02
                                                BA 23
                                        39 01 00 00 00 00 04
                                                BC 00 78 00
                                        39 01 00 00 00 00 04
                                                BD 00 78 00
                                        39 01 00 00 00 00 02
                                                BE 34
                                        39 01 00 00 00 00 11
                                                D1 00 1C 00 38 00 5C 00 7A 00 91 00 B6 00 D5 01 07
                                        39 01 00 00 00 00 11
                                                D2 01 2F 01 6E 01 9F 01 EC 02 28 02 29 02 61 02 9C
                                        39 01 00 00 00 00 11
                                                D3 02 C0 02 ED 03 0A 03 2D 03 40 03 50 03 56 03 5B
                                        39 01 00 00 00 00 05
                                                D4 03 5D 03 5D
                                        39 01 00 00 00 00 11
                                                D5 00 1C 00 38 00 5C 00 7A 00 91 00 B6 00 D5 01 07
                                        39 01 00 00 00 00 11
                                                D6 01 2F 01 6E 01 9F 01 EC 02 28 02 29 02 61 02 9C
                                        39 01 00 00 00 00 11
                                                D7 02 C0 02 ED 03 0A 03 2D 03 40 03 50 03 56 03 5B
                                        39 01 00 00 00 00 05
                                                D8 03 5D 03 5D
                                        39 01 00 00 00 00 11
                                                D9 00 1C 00 38 00 5C 00 7A 00 91 00 B6 00 D5 01 07
                                        39 01 00 00 00 00 11
                                                DD 01 2F 01 6E 01 9F 01 EC 02 28 02 29 02 61 02 9C
                                        39 01 00 00 00 00 11
                                                DE 02 C0 02 ED 03 0A 03 2D 03 40 03 50 03 56 03 5B
                                        39 01 00 00 00 00 05
                                                DF 03 5D 03 5D
                                        39 01 00 00 00 00 11
                                                E0 00 1C 00 38 00 5C 00 7A 00 91 00 B6 00 D5 01 07
                                        39 01 00 00 00 00 11
                                                E1 01 2F 01 6E 01 9F 01 EC 02 28 02 29 02 61 02 9C
                                        39 01 00 00 00 00 11
                                                E2 02 C0 02 ED 03 0A 03 2D 03 40 03 50 03 56 03 5B
                                        39 01 00 00 00 00 05
                                                E3 03 5D 03 5D
                                        39 01 00 00 00 00 11
                                                E4 00 1C 00 38 00 5C 00 7A 00 91 00 B6 00 D5 01 07
                                        39 01 00 00 00 00 11
                                                E5 01 2F 01 6E 01 9F 01 EC 02 28 02 29 02 61 02 9C
                                        39 01 00 00 00 00 11
                                                E6 02 C0 02 ED 03 0A 03 2D 03 40 03 50 03 56 03 5B
                                        39 01 00 00 00 00 05
                                                E7 03 5D 03 5D
                                        39 01 00 00 00 00 11
                                                E8 00 1C 00 38 00 5C 00 7A 00 91 00 B6 00 D5 01 07
                                        39 01 00 00 00 00 11
                                                E9 01 2F 01 6E 01 9F 01 EC 02 28 02 29 02 61 02 9C
                                        39 01 00 00 00 00 11
                                                EA 02 C0 02 ED 03 0A 03 2D 03 40 03 50 03 56 03 5B
                                        39 01 00 00 00 00 05
                                                EB 03 5D 03 5D
                                        39 01 00 00 00 00 05
                                                FF AA 55 25 01
                                        39 01 00 00 00 00 02
                                                6F 0B
                                        39 01 00 00 00 00 05
                                                F4 12 12 56 13
                                        39 01 00 00 00 00 02
                                                51 00
                                        39 01 00 00 00 00 02
                                                53 24
                                        39 01 00 00 00 00 02
                                                55 01
                                        39 01 00 00 00 00 02
                                                35 00
                                        05 01 00 00 78 00 02
                                                11 00
                                        05 01 00 00 14 00 02
                                                29 00];
		qcom,mdss-dsi-off-command = [05 01 00 00 32 00 02 28 00
					05 01 00 00 78 00 02 10 00];
		qcom,mdss-dsi-on-command-state = "dsi_lp_mode";
		qcom,mdss-dsi-off-command-state = "dsi_lp_mode";
		qcom,mdss-dsi-h-sync-pulse = <1>;
		qcom,mdss-dsi-traffic-mode = <2>;
		qcom,mdss-dsi-lane-map = <1>;
		qcom,mdss-dsi-bllp-eof-power-mode;
		qcom,mdss-dsi-bllp-power-mode;
		qcom,mdss-dsi-lane-0-state;
		qcom,mdss-dsi-lane-1-state;
		qcom,mdss-dsi-panel-timings = [75 1a 11 00 3d 45 15 1d 1c 03 04 00];
		qcom,mdss-dsi-t-clk-post = <0x04>;
		qcom,mdss-dsi-t-clk-pre = <0x1b>;
		qcom,mdss-dsi-bl-min-level = <1>;
		qcom,mdss-dsi-bl-max-level = <255>;
		qcom,mdss-dsi-dma-trigger = <4>;
		qcom,mdss-dsi-mdp-trigger = <0>;
		qcom,mdss-dsi-bl-pmic-control-type = "bl_ctrl_dcs";
		qcom,panel-cabc-ui-cmds = [13 01 00 00 00 02 55 01
						13 01 00 00 00 02 53 24];
		qcom,cabc-ui-cmds-dsi-state = "DSI_LP_MODE";
		qcom,panel-cabc-video-cmds = [13 01 00 00 00 02 55 03
						13 01 00 00 00 02 53 2c];
		qcom,cabc-video-cmds-dsi-state = "DSI_LP_MODE";
		qcom,panel-gamma-22-cmds = [13 01 00 00 00 02 55 01
						13 01 00 00 00 02 53 24];
		qcom,gamma-22-cmds-dsi-state = "DSI_LP_MODE";
		qcom,panel-gamma-25-cmds = [13 01 00 00 00 02 55 03
						13 01 00 00 00 02 53 2c];
		qcom,gamma-25-cmds-dsi-state = "DSI_LP_MODE";
	};
};
