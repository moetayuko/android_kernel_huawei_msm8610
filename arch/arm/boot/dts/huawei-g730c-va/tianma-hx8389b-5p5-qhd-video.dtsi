//modify the timingsetting
/* recreat lcd dts in fc1 baseline */
/* Copyright (c) 2013, The Linux Foundation. All rights reserved.
 *
 * This program is free software; you can redistribute it and/or modify
 * it under the terms of the GNU General Public License version 2 and
 * only version 2 as published by the Free Software Foundation.
 *
 * This program is distributed in the hope that it will be useful,
 * but WITHOUT ANY WARRANTY; without even the implied warranty of
 * MERCHANTABILITY or FITNESS FOR A PARTICULAR PURPOSE.  See the
 * GNU General Public License for more details.
 */
&mdss_mdp {
		dsi_tianma_hx8389b_5p5_qhd_vid: qcom,mdss_dsi_tianma_hx8389b_5p5_qhd_video {
		qcom,mdss-dsi-panel-name = "TIANMA_HX8389B_QHD_VIDEO";
		qcom,mdss-dsi-panel-controller = <&mdss_dsi0>;
		qcom,mdss-dsi-panel-type = "dsi_video_mode";
		qcom,mdss-dsi-panel-destination = "display_1";
		qcom,mdss-dsi-panel-framerate = <60>;
		qcom,mdss-dsi-virtual-channel-id = <0>;
		qcom,mdss-dsi-stream = <0>;
		qcom,mdss-dsi-panel-width = <540>;
		qcom,mdss-dsi-panel-height = <960>;
		qcom,mdss-dsi-h-front-porch = <96>;
		qcom,mdss-dsi-h-back-porch = <96>;
		qcom,mdss-dsi-h-pulse-width = <8>;
		qcom,mdss-dsi-h-sync-skew = <0>;
		qcom,mdss-dsi-v-back-porch = <6>;
		qcom,mdss-dsi-v-front-porch = <6>;
		qcom,mdss-dsi-v-pulse-width = <4>;
		qcom,mdss-dsi-h-left-border = <0>;
		qcom,mdss-dsi-h-right-border = <0>;
		qcom,mdss-dsi-v-top-border = <0>;
		qcom,mdss-dsi-v-bottom-border = <0>;
		qcom,mdss-dsi-bpp = <24>;
		qcom,mdss-dsi-color-order = <0>;
		qcom,mdss-dsi-underflow-color = <0xff>;
		qcom,mdss-dsi-border-color = <0>;
		qcom,mdss-dsi-on-command = [39 01 00 00 00 00 04
						B9 FF 83 89
					39 01 00 00 01 00 08
						BA 41 93 00 16 A4 10 18
					39 01 00 00 01 00 02
						C6 08
					39 01 00 00 01 00 14
						B1 00 00 07 EF 97 10 11
						94 F1 26 2E 3F 3F 42 01
						32 F7 20 80
					39 01 00 00 0a 00 04
						DE 05 58 10
					39 01 00 00 00 00 08
						B2 00 00 78 0E 03 3F 80
					39 01 00 00 01 00 18
						B4 80 08 00 32 10 07 32
						10 07 32 10 07 27 01 5A
						0B 37 05 4C 14 50 5B 0a
					39 01 00 00 0a 00 31
						D5 00 00 00 00 01 00 00
						00 60 00 99 88 88 88 88
						23 88 01 88 67 88 45 01
						23 23 88 88 88 88 88 99
						88 88 88 54 88 76 88 10
						88 32 32 10 88 88 88 88
						88
					39 01 00 00 0a 00 23
						E0 01 1B 21 34 32 3F 32
						4B 07 0D 10 13 16 13 14
						0F 19 01 1B 21 34 32 3F
						32 4B 07 0D 10 13 16 13
						14 0F 19
					39 01 00 00 05 00 05
						B6 00 89 00 89
					39 01 00 00 01 00 02
						CC 02
					39 01 00 00 00 00 04
						B7 00 00 50
					39 01 00 00 00 00 02
						E6 01
					39 01 00 00 00 00 02
						E4 00
					39 01 00 00 0a 00 02
						51 00
					39 01 00 00 00 00 02
						53 24
					39 01 00 00 00 00 02
						55 01
					05 01 00 00 0a 00 02
						11 00
					05 01 00 00 78 00 02
						29 00
					];
		qcom,mdss-dsi-off-command = [05 01 00 00 32 00 02 28 00
					05 01 00 00 78 00 02 10 00];
		qcom,mdss-dsi-on-command-state = "dsi_lp_mode";
		qcom,mdss-dsi-off-command-state = "dsi_lp_mode";
		qcom,mdss-dsi-h-sync-pulse = <1>;
		qcom,mdss-dsi-traffic-mode = <2>;
		qcom,mdss-dsi-lane-map = <1>;
		qcom,mdss-dsi-bllp-eof-power-mode;
		qcom,mdss-dsi-bllp-power-mode;
		qcom,mdss-dsi-hfpPowerMode;
		qcom,mdss-dsi-hbpPowerMode;
		qcom,mdss-dsi-hsaPowerMode;
		qcom,mdss-dsi-lane-0-state;
		qcom,mdss-dsi-lane-1-state;
		qcom,mdss-dsi-panel-timings = [54 10 0a 00 30 35 0f 14 12 03 04 00];
		qcom,mdss-dsi-t-clk-post = <0x04>;
		qcom,mdss-dsi-t-clk-pre = <0x1b>;
		qcom,mdss-dsi-bl-min-level = <1>;
		qcom,mdss-dsi-bl-max-level = <255>;
		qcom,mdss-dsi-dma-trigger = <4>;
		qcom,mdss-dsi-mdp-trigger = <0>;
		qcom,mdss-dsi-bl-pmic-control-type = "bl_ctrl_dcs";
		qcom,panel-cabc-ui-cmds = [13 01 00 00 00 02 55 01
						13 01 00 00 00 02 53 24];
		qcom,cabc-ui-cmds-dsi-state = "DSI_LP_MODE";
		qcom,panel-cabc-video-cmds = [13 01 00 00 00 02 55 03
						13 01 00 00 00 02 53 2c];
		qcom,cabc-video-cmds-dsi-state = "DSI_LP_MODE";
		qcom,panel-gamma-22-cmds = [13 01 00 00 00 02 55 01
						13 01 00 00 00 02 53 24];
		qcom,gamma-22-cmds-dsi-state = "DSI_LP_MODE";
		qcom,panel-gamma-25-cmds = [13 01 00 00 00 02 55 03
						13 01 00 00 00 02 53 2c];
		qcom,gamma-25-cmds-dsi-state = "DSI_LP_MODE";
	};
};
