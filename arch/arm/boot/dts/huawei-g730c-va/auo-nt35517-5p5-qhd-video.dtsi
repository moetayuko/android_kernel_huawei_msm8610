//modify the timingsetting and PWM frequency
/* recreat lcd dts in fc1 baseline */
/* Copyright (c) 2013, The Linux Foundation. All rights reserved.
 *
 * This program is free software; you can redistribute it and/or modify
 * it under the terms of the GNU General Public License version 2 and
 * only version 2 as published by the Free Software Foundation.
 *
 * This program is distributed in the hope that it will be useful,
 * but WITHOUT ANY WARRANTY; without even the implied warranty of
 * MERCHANTABILITY or FITNESS FOR A PARTICULAR PURPOSE.  See the
 * GNU General Public License for more details.
 */

&mdss_mdp {
		dsi_auo_nt35517_5p5_qhd_vid: qcom,mdss_dsi_auo_nt35517_5p5_qhd_video {
		qcom,mdss-dsi-panel-name = "AUO_NT35517_QHD_VIDEO";
		qcom,mdss-dsi-panel-controller = <&mdss_dsi0>;
		qcom,mdss-dsi-panel-type = "dsi_video_mode";
		qcom,mdss-dsi-panel-destination = "display_1";
		qcom,mdss-dsi-panel-framerate = <60>;
		qcom,mdss-dsi-virtual-channel-id = <0>;
		qcom,mdss-dsi-stream = <0>;
		qcom,mdss-dsi-panel-width = <540>;
		qcom,mdss-dsi-panel-height = <960>;
		qcom,mdss-dsi-h-front-porch = <75>;
		qcom,mdss-dsi-h-back-porch = <75>;
		qcom,mdss-dsi-h-pulse-width = <8>;
		qcom,mdss-dsi-h-sync-skew = <0>;
		qcom,mdss-dsi-v-back-porch = <75>;
		qcom,mdss-dsi-v-front-porch = <75>;
		qcom,mdss-dsi-v-pulse-width = <8>;
		qcom,mdss-dsi-h-left-border = <0>;
		qcom,mdss-dsi-h-right-border = <0>;
		qcom,mdss-dsi-v-top-border = <0>;
		qcom,mdss-dsi-v-bottom-border = <0>;
		qcom,mdss-dsi-bpp = <24>;
		qcom,mdss-dsi-color-order = <0>;
		qcom,mdss-dsi-underflow-color = <0xff>;
		qcom,mdss-dsi-border-color = <0>;
		qcom,mdss-dsi-on-command = [39 01 00 00 00 00 06
                                         F0 55 AA 52 08 00
                                39 01 00 00 00 00 03
                                         B1 68 00
                                39 01 00 00 00 00 02
                                         B3 82
                                39 01 00 00 00 00 13
                                         C8 01 02 45 45 45 45 45
                                         45 45 45 45 45 45 45 45
                                         45 45 45
                                39 01 00 00 00 00 02
                                         BC 05
                                39 01 00 00 00 00 02
                                         BA 05
                                /*modify tne PWM frequency*/
                                39 01 00 00 00 00 03
                                         E0 00 01
                                39 01 00 00 00 00 06
                                         F0 55 AA 52 08 01
                                39 01 00 00 00 00 04
                                         BC 00 6C 00
                                39 01 00 00 00 00 04
                                         BD 00 6C 00
                                39 01 00 00 00 00 02
                                         BE 48
                                39 01 00 00 00 00 02
                                         CF 00
                                39 01 00 00 00 00 11
                                         D1 00 37 00 38 00 74 00
                                         9A 00 B8 00 E4 01 07 01
                                         3D
                                39 01 00 00 00 00 11
                                         D2 01 66 01 A5 01 D6 02
                                         1E 02 58 02 59 02 90 02
                                         CD
                                39 01 00 00 00 00 11
                                         D3 02 F3 03 26 03 46 03
                                         5C 03 77 03 94 03 9F 03
                                         Ac
                                39 01 00 00 00 00 05
                                         D4 03 BA 03 C1
                                39 01 00 00 00 00 11
                                         D5 00 37 00 38 00 74 00
                                         9A 00 B8 00 E4 01 07 01
                                         3D
                                39 01 00 00 00 00 11
                                         D6 01 66 01 A5 01 D6 02
                                         1E 02 58 02 59 02 90 02
                                         CD
                                39 01 00 00 00 00 11
                                         D7 02 F3 03 26 03 46 03
                                         5C 03 77 03 94 03 9F 03
                                         Ac
                                39 01 00 00 00 00 05
                                         D8 03 BA 03 C1
                                39 01 00 00 00 00 11
                                         D9 00 37 00 38 00 74 00
                                         9A 00 B8 00 E4 01 07 01
                                         3D
                                39 01 00 00 00 00 11
                                         DD 01 66 01 A5 01 D6 02
                                         1E 02 58 02 59 02 90 02
                                         CD
                                39 01 00 00 00 00 11
                                         DE 02 F3 03 26 03 46 03
                                         5C 03 77 03 94 03 9F 03
                                         Ac
                                39 01 00 00 00 00 05
                                         DF 03 BA 03 C1
                                39 01 00 00 00 00 11
                                         E0 00 37 00 38 00 74 00
                                         9A 00 B8 00 E4 01 07 01
                                         3D
                                39 01 00 00 00 00 11
                                         E1 01 66 01 A5 01 D6 02
                                         1E 02 58 02 59 02 90 02
                                         CD
                                39 01 00 00 00 00 11
                                         E2 02 F3 03 26 03 46 03
                                         5C 03 77 03 94 03 9F 03
                                         Ac
                                39 01 00 00 00 00 05
                                         E3 03 BA 03 C1
                                39 01 00 00 00 00 11
                                         E4 00 37 00 38 00 74 00
                                         9A 00 B8 00 E4 01 07 01
                                         3D
                                39 01 00 00 00 00 11
                                         E5 01 66 01 A5 01 D6 02
                                         1E 02 58 02 59 02 90 02
                                         CD
                                39 01 00 00 00 00 11
                                         E6 02 F3 03 26 03 46 03
                                         5C 03 77 03 94 03 9F 03
                                         Ac
                                39 01 00 00 00 00 05
                                         E7 03 BA 03 C1
                                39 01 00 00 00 00 11
                                         E8 00 37 00 38 00 74 00
                                         9A 00 B8 00 E4 01 07 01
                                         3D
                                39 01 00 00 00 00 11
                                         E9 01 66 01 A5 01 D6 02
                                         1E 02 58 02 59 02 90 02
                                         CD
                                39 01 00 00 00 00 11
                                         Ea 02 F3 03 26 03 46 03
                                         5C 03 77 03 94 03 9F 03
                                         Ac
                                39 01 00 00 00 00 05
                                         Eb 03 BA 03 C1
                                39 01 00 00 00 00 02
                                         B2 03
                                39 01 00 00 00 00 02
                                         B3 10
                                39 01 00 00 00 00 02
                                         B4 0A
                                39 01 00 00 00 00 05
                                         FF AA 55 25 01
                                39 01 00 00 00 00 02
                                         F3 02
                                39 01 00 00 00 00 02
                                         6F 17
                                39 01 00 00 00 00 02
                                         F2 20
                                39 01 00 00 28 00 02
                                         35 00
                                39 01 00 00 00 00 02
                                         51 00
                                39 01 00 00 00 00 02
                                         53 24
                                39 01 00 00 00 00 02
                                         55 01
                                05 01 00 00 78 00 02
                                         11 00
                                05 01 00 00 14 00 02
                                         29 00
					];
		qcom,mdss-dsi-off-command = [05 01 00 00 32 00 02 28 00
					05 01 00 00 78 00 02 10 00];
		qcom,mdss-dsi-on-command-state = "dsi_lp_mode";
		qcom,mdss-dsi-off-command-state = "dsi_lp_mode";
		qcom,mdss-dsi-h-sync-pulse = <1>;
		qcom,mdss-dsi-traffic-mode = <2>;
		qcom,mdss-dsi-lane-map = <1>;
		qcom,mdss-dsi-bllp-eof-power-mode;
		qcom,mdss-dsi-bllp-power-mode;
		qcom,mdss-dsi-lane-0-state;
		qcom,mdss-dsi-lane-1-state;
		qcom,mdss-dsi-panel-timings = [99 23 18 00 4b 52 1c 27 28 03 04 00];
		qcom,mdss-dsi-t-clk-post = <0x04>;
		qcom,mdss-dsi-t-clk-pre = <0x1b>;
		qcom,mdss-dsi-bl-min-level = <1>;
		qcom,mdss-dsi-bl-max-level = <255>;
		qcom,mdss-dsi-dma-trigger = <4>;
		qcom,mdss-dsi-mdp-trigger = <0>;
		qcom,mdss-dsi-bl-pmic-control-type = "bl_ctrl_dcs";
		qcom,panel-cabc-ui-cmds = [13 01 00 00 00 02 55 01
						13 01 00 00 00 02 53 24];
		qcom,cabc-ui-cmds-dsi-state = "DSI_LP_MODE";
		qcom,panel-cabc-video-cmds = [13 01 00 00 00 02 55 03
						13 01 00 00 00 02 53 2c];
		qcom,cabc-video-cmds-dsi-state = "DSI_LP_MODE";
		qcom,panel-gamma-22-cmds = [13 01 00 00 00 02 55 01
						13 01 00 00 00 02 53 24];
		qcom,gamma-22-cmds-dsi-state = "DSI_LP_MODE";
		qcom,panel-gamma-25-cmds = [13 01 00 00 00 02 55 03
						13 01 00 00 00 02 53 2c];
		qcom,gamma-25-cmds-dsi-state = "DSI_LP_MODE";
	};
};
