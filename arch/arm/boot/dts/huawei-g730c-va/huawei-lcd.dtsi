/include/ "tianma-hx8389b-5p5-qhd-video.dtsi"
/include/ "byd-nt35517-5p5-qhd-video.dtsi"
/include/ "boe-nt35517-5p5-qhd-video.dtsi"
/include/ "auo-otm9605a-5p5-qhd-video.dtsi"
/include/ "auo-nt35517-5p5-qhd-video.dtsi"