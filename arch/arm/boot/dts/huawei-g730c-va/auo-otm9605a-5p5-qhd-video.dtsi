//modify the timingsetting PWM frequency and unnecessary time delay
/* recreat lcd dts in fc1 baseline */
/* Copyright (c) 2013, The Linux Foundation. All rights reserved.
 *
 * This program is free software; you can redistribute it and/or modify
 * it under the terms of the GNU General Public License version 2 and
 * only version 2 as published by the Free Software Foundation.
 *
 * This program is distributed in the hope that it will be useful,
 * but WITHOUT ANY WARRANTY; without even the implied warranty of
 * MERCHANTABILITY or FITNESS FOR A PARTICULAR PURPOSE.  See the
 * GNU General Public License for more details.
 */
&mdss_mdp {
		dsi_auo_otm9605a_5p5_qhd_vid: qcom,mdss_dsi_auo_otm9605a_5p5_qhd_video {
		qcom,mdss-dsi-panel-name = "AUO_OTM9605A_QHD_VIDEO";
		qcom,mdss-dsi-panel-controller = <&mdss_dsi0>;
		qcom,mdss-dsi-panel-type = "dsi_video_mode";
		qcom,mdss-dsi-panel-destination = "display_1";
		qcom,mdss-dsi-panel-framerate = <60>;
		qcom,mdss-dsi-virtual-channel-id = <0>;
		qcom,mdss-dsi-stream = <0>;
		qcom,mdss-dsi-panel-width = <540>;
		qcom,mdss-dsi-panel-height = <960>;
		qcom,mdss-dsi-h-front-porch = <100>;
		qcom,mdss-dsi-h-back-porch = <100>;
		qcom,mdss-dsi-h-pulse-width = <4>;
		qcom,mdss-dsi-h-sync-skew = <0>;
		qcom,mdss-dsi-v-back-porch = <32>;
		qcom,mdss-dsi-v-front-porch = <32>;
		qcom,mdss-dsi-v-pulse-width = <4>;
		qcom,mdss-dsi-h-left-border = <0>;
		qcom,mdss-dsi-h-right-border = <0>;
		qcom,mdss-dsi-v-top-border = <0>;
		qcom,mdss-dsi-v-bottom-border = <0>;
		qcom,mdss-dsi-bpp = <24>;
		qcom,mdss-dsi-color-order = <0>;
		qcom,mdss-dsi-underflow-color = <0xff>;
		qcom,mdss-dsi-border-color = <0>;
		qcom,mdss-dsi-on-command = [39 01 00 00 00 00 02 00 00
                                        39 01 00 00 00 00 04 FF 96 05 01
                                        39 01 00 00 00 00 02 00 80
                                        39 01 00 00 00 00 03 FF 96 05
                                        39 01 00 00 00 00 02 00 80
                                        39 01 00 00 00 00 03 C1 36 66
                                        39 01 00 00 00 00 02 00 89
                                        39 01 00 00 00 00 02 C0 01
                                        /*modify tne PWM frequency*/
                                        39 01 00 00 00 00 02 00 B1
                                        39 01 00 00 00 00 02 C6 0C
                                        39 01 00 00 00 00 02 00 80
                                        39 01 00 00 00 00 02 C4 9C
                                        39 01 00 00 00 00 02 00 A0
                                        39 01 00 00 00 00 02 C1 00
                                        39 01 00 00 00 00 02 00 C0
                                        39 01 00 00 00 00 02 C5 00
                                        39 01 00 00 00 00 02 00 C5
                                        39 01 00 00 00 00 02 B0 03
                                        39 01 00 00 00 00 02 00 B4
                                        39 01 00 00 00 00 02 C0 50
                                        39 01 00 00 00 00 02 00 91
                                        39 01 00 00 00 00 02 C5 79
                                        39 01 00 00 00 00 02 00 00
                                        39 01 00 00 00 00 03 D8 67 67
                                        39 01 00 00 00 00 02 00 A6
                                        39 01 00 00 00 00 02 B3 0B
                                        39 01 00 00 00 00 02 00 A7
                                        39 01 00 00 00 00 02 B3 01
                                        39 01 00 00 00 00 02 00 80
                                        39 01 00 00 00 00 0B CB 00 00 00 00 00 00 00 00 00 00
                                        39 01 00 00 00 00 02 00 90
                                        39 01 00 00 00 00 10 CB 00 00 00 00 00 00 00 00 00 00 00 00 00 00 00
                                        39 01 00 00 00 00 02 00 A0
                                        39 01 00 00 00 00 10 CB 00 00 00 00 00 00 00 00 00 00 00 00 00 00 00
                                        39 01 00 00 00 00 02 00 B0
                                        39 01 00 00 00 00 0B CB 00 00 00 00 00 00 00 00 00 00
                                        39 01 00 00 00 00 02 00 C0
                                        39 01 00 00 00 00 10 CB 00 00 04 04 04 04 04 04 00 00 00 00 00 00 00
                                        39 01 00 00 00 00 02 00 D0
                                        39 01 00 00 00 00 10 CB 00 00 00 00 00 00 00 04 04 04 04 04 04 00 00
                                        39 01 00 00 00 00 02 00 E0
                                        39 01 00 00 00 00 0B CB 00 00 00 00 00 00 00 00 00 00
                                        39 01 00 00 00 00 02 00 F0
                                        39 01 00 00 00 00 0B CB FF FF FF FF FF FF FF FF FF FF
                                        39 01 00 00 00 00 02 00 80
                                        39 01 00 00 00 00 0B CC 00 00 01 0D 0F 0B 09 05 00 00
                                        39 01 00 00 00 00 02 00 90
                                        39 01 00 00 00 00 10 CC 00 00 00 00 00 00 00 00 00 00 00 00 02 0E 10
                                        39 01 00 00 00 00 02 00 A0
                                        39 01 00 00 00 00 10 CC 0C 0A 06 00 00 00 00 00 00 00 00 00 00 00 00
                                        39 01 00 00 00 00 02 00 B0
                                        39 01 00 00 00 00 0B CC 00 00 06 10 0E 0A 0C 02 00 00
                                        39 01 00 00 00 00 02 00 C0
                                        39 01 00 00 00 00 10 CC 00 00 00 00 00 00 00 00 00 00 00 00 05 0F D0
                                        39 01 00 00 00 00 02 00 D0
                                        39 01 00 00 00 00 10 CC 09 0B 01 00 00 00 00 00 00 00 00 00 00 00 00
                                        39 01 00 00 00 00 02 00 80
                                        39 01 00 00 00 00 0D CE 83 01 17 82 01 17 00 0F 00 00 0F 00
                                        39 01 00 00 00 00 02 00 90
                                        39 01 00 00 00 00 0F CE 13 BE 17 13 BF 17 F0 00 00 F0 00 00 00 00
                                        39 01 00 00 00 00 02 00 A0
                                        39 01 00 00 00 00 0F CE 18 01 03 BC 00 17 00 18 00 03 BD 00 17 00
                                        39 01 00 00 00 00 02 00 B0
                                        39 01 00 00 00 00 0F CE 10 00 03 BE 00 17 00 10 01 03 BF 00 17 00
                                        39 01 00 00 00 00 02 00 C0
                                        39 01 00 00 00 00 0F CE 18 01 03 C0 00 06 12 18 00 03 C1 00 06 12
                                        39 01 00 00 00 00 02 00 D0
                                        39 01 00 00 00 00 0F CE 18 03 03 C2 00 06 12 18 02 03 C7 00 06 12
                                        39 01 00 00 00 00 02 00 80
                                        39 01 00 00 00 00 0F CF F0 00 00 10 00 00 00 F0 00 00 10 00 00 00
                                        39 01 00 00 00 00 02 00 90
                                        39 01 00 00 00 00 0F CF F0 00 00 10 00 00 00 F0 00 00 10 00 00 00
                                        39 01 00 00 00 00 02 00 A0
                                        39 01 00 00 00 00 0F CF F0 00 00 10 00 00 00 F0 00 00 10 00 00 00
                                        39 01 00 00 00 00 02 00 B0
                                        39 01 00 00 00 00 0F CF F0 00 00 10 00 00 00 F0 00 00 10 00 00 00
                                        39 01 00 00 00 00 02 00 C0
                                        39 01 00 00 00 00 0B CF 01 01 00 00 00 00 01 02 00 00
                                        39 01 00 00 00 00 02 00 00
                                        39 01 00 00 00 00 11 E1 00 08 0E 0C 05 10 0C 0B 03 07 0B 08 0F 12 0B 02
                                        39 01 00 00 00 00 02 00 00
                                        39 01 00 00 00 00 11 E2 00 08 0E 0C 05 10 0C 0B 03 07 0B 08 0F 12 0B 02
                                        39 01 00 00 00 00 02 51 00
                                        39 01 00 00 00 00 02 53 24
                                        39 01 00 00 00 00 02 55 01
                                        05 01 00 00 78 00 02 11 00
                                        05 01 00 00 14 00 02 29 00];
		qcom,mdss-dsi-off-command = [05 01 00 00 32 00 02 28 00
					05 01 00 00 78 00 02 10 00];
		qcom,mdss-dsi-on-command-state = "dsi_lp_mode";
		qcom,mdss-dsi-off-command-state = "dsi_lp_mode";
		qcom,mdss-dsi-h-sync-pulse = <1>;
		qcom,mdss-dsi-traffic-mode = <2>;
		qcom,mdss-dsi-lane-map = <1>;
		qcom,mdss-dsi-bllp-eof-power-mode;
		qcom,mdss-dsi-bllp-power-mode;
		qcom,mdss-dsi-hfpPowerMode;
		qcom,mdss-dsi-hbpPowerMode;
		qcom,mdss-dsi-hsaPowerMode;
		qcom,mdss-dsi-lane-0-state;
		qcom,mdss-dsi-lane-1-state;
		qcom,mdss-dsi-panel-timings = [96 22 17 00 4a  54 1b 26 27 03 04 00];
		qcom,mdss-dsi-t-clk-post = <0x04>;
		qcom,mdss-dsi-t-clk-pre = <0x1b>;
		qcom,mdss-dsi-bl-min-level = <1>;
		qcom,mdss-dsi-bl-max-level = <255>;
		qcom,mdss-dsi-dma-trigger = <4>;
		qcom,mdss-dsi-mdp-trigger = <0>;
		qcom,mdss-dsi-bl-pmic-control-type = "bl_ctrl_dcs";
		qcom,panel-cabc-ui-cmds = [13 01 00 00 00 02 55 01
						13 01 00 00 00 02 53 24];
		qcom,cabc-ui-cmds-dsi-state = "DSI_LP_MODE";
		qcom,panel-cabc-video-cmds = [13 01 00 00 00 02 55 03
						13 01 00 00 00 02 53 2c];
		qcom,cabc-video-cmds-dsi-state = "DSI_LP_MODE";
		qcom,panel-gamma-22-cmds = [13 01 00 00 00 02 55 01
						13 01 00 00 00 02 53 24];
		qcom,gamma-22-cmds-dsi-state = "DSI_LP_MODE";
		qcom,panel-gamma-25-cmds = [13 01 00 00 00 02 55 03
						13 01 00 00 00 02 53 2c];
		qcom,gamma-25-cmds-dsi-state = "DSI_LP_MODE";
	};
};

