 / {
        huawei_fac_info {
                  compatible = "huawei,hw_fac_info";
                  fac,product_name = "G6_U251";
                  fac,hardware_ver = "HC1G6TM_VERA";
		  fac,software_ver = "MSM8x12_G6_U251_va";
                  status = "ok";
        };
};
