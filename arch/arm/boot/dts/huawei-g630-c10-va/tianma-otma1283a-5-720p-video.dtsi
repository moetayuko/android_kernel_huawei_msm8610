/* Copyright (c) 2013, The Linux Foundation. All rights reserved.
 *
 * This program is free software; you can redistribute it and/or modify
 * it under the terms of the GNU General Public License version 2 and
 * only version 2 as published by the Free Software Foundation.
 *
 * This program is distributed in the hope that it will be useful,
 * but WITHOUT ANY WARRANTY; without even the implied warranty of
 * MERCHANTABILITY or FITNESS FOR A PARTICULAR PURPOSE.  See the
 * GNU General Public License for more details.
 */

/*---------------------------------------------------------------------------
 * This file is autogenerated file using gcdb parser. Please do not edit it.
 * Update input XML file to add a new entry or update variable in this file
 * VERSION = "1.0"
 *---------------------------------------------------------------------------*/
&mdss_mdp {
	dsi_tianma_otma1283a_5_720p_video: qcom,mdss_dsi_tianma_otma1283a_5_720p_video {
		qcom,mdss-dsi-panel-name = "TIANMA_OTMA1283A_5_720P_VIDEO";
		qcom,cont-splash-enabled;
		qcom,mdss-dsi-panel-controller = <&mdss_dsi0>;
		qcom,mdss-dsi-panel-type = "dsi_video_mode";
		qcom,mdss-dsi-panel-destination = "display_1";
		qcom,mdss-dsi-panel-framerate = <60>;
		qcom,mdss-dsi-virtual-channel-id = <0>;
		qcom,mdss-dsi-stream = <0>;
		qcom,mdss-dsi-panel-width = <720>;
		qcom,mdss-dsi-panel-height = <1280>;
		qcom,mdss-dsi-h-front-porch = <64>;
		qcom,mdss-dsi-h-back-porch = <64>;
		qcom,mdss-dsi-h-pulse-width = <12>;
		qcom,mdss-dsi-h-sync-skew = <0>;
		qcom,mdss-dsi-v-back-porch = <13>;
		qcom,mdss-dsi-v-front-porch = <10>;
		qcom,mdss-dsi-v-pulse-width = <5>;
		qcom,mdss-dsi-h-left-border = <0>;
		qcom,mdss-dsi-h-right-border = <0>;
		qcom,mdss-dsi-v-top-border = <0>;
		qcom,mdss-dsi-v-bottom-border = <0>;
		qcom,mdss-dsi-bpp = <24>;
		qcom,mdss-dsi-color-order = <0>;
		qcom,mdss-dsi-underflow-color = <0xff>;
		qcom,mdss-dsi-border-color = <0>;
		qcom,mdss-dsi-on-command = [29 01 00 00 00 00 02 00 00
				29 01 00 00 00 00 04 FF 12 83 01
				29 01 00 00 00 00 02 00 80
				29 01 00 00 00 00 03 FF 12 83
				29 01 00 00 00 00 02 00 80
				29 01 00 00 00 00 0A C0 00 64 00 0E 12 00 64 0E 12
				29 01 00 00 00 00 02 00 B4
				29 01 00 00 00 00 02 C0 55
				29 01 00 00 00 00 02 00 80
				29 01 00 00 00 00 02 C4 30
				29 01 00 00 00 00 02 00 8A
				29 01 00 00 00 00 02 C4 40
				29 01 00 00 00 00 02 00 B1
				29 01 00 00 00 00 02 C6 02
				29 01 00 00 00 00 02 00 B4
				29 01 00 00 00 00 02 C6 02
				29 01 00 00 00 00 02 00 81
				29 01 00 00 00 00 02 C1 55
				29 01 00 00 00 00 02 00 A0
				29 01 00 00 00 00 02 C1 00
				29 01 00 00 00 00 02 00 81
				29 01 00 00 00 00 02 C4 82
				29 01 00 00 00 00 02 00 90
				29 01 00 00 00 00 02 C4 49
				29 01 00 00 00 00 02 00 82
				29 01 00 00 00 00 02 C4 02
				29 01 00 00 00 00 02 00 C6
				29 01 00 00 00 00 02 B0 03
				29 01 00 00 00 00 02 00 A0
				29 01 00 00 00 00 0F C4 05 10 06 02 05 15 10 05 10 07 02 05 15 10
				29 01 00 00 00 00 02 00 B0
				29 01 00 00 00 00 03 C4 00 00
				29 01 00 00 00 00 02 00 BB
				29 01 00 00 00 00 02 C5 80
				29 01 00 00 00 00 02 00 91
				29 01 00 00 00 00 03 C5 16 50
				29 01 00 00 00 00 02 00 00
				29 01 00 00 00 00 03 D8 AE AE
				29 01 00 00 00 00 02 00 B0
				29 01 00 00 00 00 03 C5 04 B8
				29 01 00 00 00 00 02 00 90
				29 01 00 00 00 00 05 F5 02 11 02 11
				29 01 00 00 00 00 02 00 90
				29 01 00 00 00 00 02 C5 50
				29 01 00 00 00 00 02 00 94
				29 01 00 00 00 00 02 C5 66
				29 01 00 00 00 00 02 00 B2
				29 01 00 00 00 00 03 F5 00 00
				29 01 00 00 00 00 02 00 B4
				29 01 00 00 00 00 03 F5 00 00
				29 01 00 00 00 00 02 00 B6
				29 01 00 00 00 00 03 F5 00 00
				29 01 00 00 00 00 02 00 B8
				29 01 00 00 00 00 03 F5 00 00
				29 01 00 00 00 00 02 00 94
				29 01 00 00 00 00 02 F5 02
				29 01 00 00 00 00 02 00 BA
				29 01 00 00 00 00 02 F5 03
				29 01 00 00 00 00 02 00 B4
				29 01 00 00 00 00 02 C5 C0
				29 01 00 00 00 00 02 00 80
				29 01 00 00 00 00 02 C4 00
				29 01 00 00 00 00 02 00 80
				29 01 00 00 00 00 0C CB 00 00 00 00 00 00 00 00 00 00 00
				29 01 00 00 00 00 02 00 90
				29 01 00 00 00 00 10 CB 00 00 00 00 00 00 00 00 00 00 00 00 00 00 00
				29 01 00 00 00 00 02 00 A0
				29 01 00 00 00 00 10 CB 00 00 00 00 00 00 00 00 00 00 00 00 00 00 00
				29 01 00 00 00 00 02 00 B0
				29 01 00 00 00 00 10 CB 00 00 00 00 00 00 00 00 00 00 00 00 00 00 00
				29 01 00 00 00 00 02 00 C0
				29 01 00 00 00 00 10 CB 05 05 05 05 05 05 00 00 00 00 00 00 00 00 00
				29 01 00 00 00 00 02 00 D0
				29 01 00 00 00 00 10 CB 00 00 00 00 05 05 05 05 05 05 05 05 05 00 00
				29 01 00 00 00 00 02 00 E0
				29 01 00 00 00 00 0F CB 00 00 00 00 00 00 00 00 00 00 00 05 05 05
				29 01 00 00 00 00 02 00 F0
				29 01 00 00 00 00 0C CB FF CF 00 03 C0 F0 FF 0C 30 00 0C
				29 01 00 00 00 00 02 00 80
				29 01 00 00 00 00 10 CC 0C 0A 10 0E 02 04 00 00 00 00 00 00 00 00 00
				29 01 00 00 00 00 02 00 90
				29 01 00 00 00 00 10 CC 00 00 00 00 06 2D 2E 0B 09 0F 0D 01 03 00 00
				29 01 00 00 00 00 02 00 A0
				29 01 00 00 00 00 0F CC 00 00 00 00 00 00 00 00 00 00 00 05 2D 2E
				29 01 00 00 00 00 02 00 B0
				29 01 00 00 00 00 10 CC 0D 0F 09 0B 03 01 00 00 00 00 00 00 00 00 00
				29 01 00 00 00 00 02 00 C0
				29 01 00 00 00 00 10 CC 00 00 00 00 05 2E 2D 0E 10 0A 0C 04 02 00 00
				29 01 00 00 00 00 02 00 D0
				29 01 00 00 00 00 0F CC 00 00 00 00 00 00 00 00 00 00 00 06 2E 2D
				29 01 00 00 00 00 02 00 80
				29 01 00 00 00 00 0D CE 8B 03 18 8A 03 18 89 03 18 88 03 18
				29 01 00 00 00 00 02 00 90
				29 01 00 00 00 00 0F CE 38 10 18 38 0F 18 00 00 00 00 00 00 00 00
				29 01 00 00 00 00 02 00 A0
				29 01 00 00 00 00 0F CE 38 07 05 00 00 18 00 38 06 05 01 00 18 00
				29 01 00 00 00 00 02 00 B0
				29 01 00 00 00 00 0F CE 38 05 05 02 00 18 00 38 04 05 03 00 18 00
				29 01 00 00 00 00 02 00 C0
				29 01 00 00 00 00 0F CE 38 03 05 04 00 18 00 38 02 05 05 00 18 00
				29 01 00 00 00 00 02 00 D0
				29 01 00 00 00 00 0F CE 38 01 05 06 00 18 00 38 00 05 07 00 18 00
				29 01 00 00 00 00 02 00 80
				29 01 00 00 00 00 0F CF 00 00 00 00 00 00 00 00 00 00 00 00 00 00
				29 01 00 00 00 00 02 00 90
				29 01 00 00 00 00 0F CF 00 00 00 00 00 00 00 00 00 00 00 00 00 00
				29 01 00 00 00 00 02 00 A0
				29 01 00 00 00 00 0F CF 00 00 00 00 00 00 00 00 00 00 00 00 00 00
				29 01 00 00 00 00 02 00 B0
				29 01 00 00 00 00 0F CF 00 00 00 00 00 00 00 00 00 00 00 00 00 00
				29 01 00 00 00 00 02 00 C0
				29 01 00 00 00 00 0C CF 01 01 20 20 00 00 01 81 00 03 08
				29 01 00 00 00 00 02 00 B5
				29 01 00 00 00 00 07 C5 38 20 BF 38 20 BF
				29 01 00 00 00 00 02 00 00
				29 01 00 00 00 00 11 E1 05 0E 14 0D 06 10 0B 0A 03 07 09 07 0E 14 11 02
				29 01 00 00 00 00 02 00 00
				29 01 00 00 00 00 11 E2 05 0E 14 0D 06 11 0B 0A 03 07 0A 07 0E 15 11 02
				29 01 00 00 00 00 02 00 92
				29 01 00 00 00 00 03 FF 30 02
				39 01 00 00 0A 00 02 35 00
				39 01 00 00 0A 00 02 51 00
				39 01 00 00 00 00 02 53 24
				39 01 00 00 00 00 02 55 01
				05 01 00 00 78 00 02 11 00
				05 01 00 00 16 00 02 29 00];
		qcom,mdss-dsi-off-command = [05 01 00 00 32 00 02 28 00
				05 01 00 00 78 00 02 10 00];
		qcom,mdss-dsi-on-command-state = "dsi_lp_mode";
		qcom,mdss-dsi-off-command-state = "dsi_hs_mode";
		qcom,mdss-dsi-h-sync-pulse = <1>;
		qcom,mdss-dsi-traffic-mode = <2>;
		qcom,mdss-dsi-lane-map = <0>;
		qcom,mdss-dsi-bllp-eof-power-mode;
		qcom,mdss-dsi-bllp-power-mode;
		qcom,mdss-dsi-lane-0-state;
		qcom,mdss-dsi-lane-1-state;
		qcom,mdss-dsi-lane-2-state;
		qcom,mdss-dsi-lane-3-state;
		qcom,mdss-dsi-panel-timings = [75 1a 11 00 3d 45 17 1d 1c 03 04 00];
		qcom,mdss-dsi-reset-sequence = <2 1>, <0 20>, <2 120>;
		qcom,mdss-dsi-t-clk-post = <0x04>;
		qcom,mdss-dsi-t-clk-pre = <0x19>;
		qcom,mdss-dsi-bl-min-level = <1>;
		qcom,mdss-dsi-bl-max-level = <255>;
		qcom,mdss-dsi-dma-trigger = <4>;
		qcom,mdss-dsi-mdp-trigger = <0>;
		qcom,mdss-dsi-bl-pmic-control-type = "bl_ctrl_dcs";
		qcom,panel-cabc-ui-cmds = [15 01 00 00 00 00 02 55 01
					15 01 00 00 00 00 02 53 24];
		qcom,panel-cabc-video-cmds = [15 01 00 00 00 00 02 55 03
			15 01 00 00 00 00 02 53 2c];
		qcom,cabc-ui-cmds-dsi-state = "dsi_lp_mode";
		qcom,cabc-video-cmds-dsi-state = "dsi_lp_mode";
		huawei,bias-ic-enable;
	};
};
